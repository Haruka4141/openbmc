## conf/layer.conf
```bitbake
# We have a conf and classes directory, add to BBPATH
BBPATH .= ":${LAYERDIR}"

# We have recipes-* directories, add to BBFILES
BBFILES += "${LAYERDIR}/recipes-*/*/*.bb \
            ${LAYERDIR}/recipes-*/*/*.bbappend"

BBFILE_COLLECTIONS += "meta-aic"
BBFILE_PATTERN_meta-aic = "^${LAYERDIR}/"
BBFILE_PRIORITY_meta-aic = "7"

PREFERRED_PROVIDER_virtual/phosphor-led-manager-config-native = "volans-led-manager-config-native"

LAYERDEPENDS_meta-aic = "meta-evb-ast2600"
LAYERSERIES_COMPAT_meta-aic = "nanbield scarthgap"

VIRTUAL-RUNTIME_obmc-host-state-manager ?= "x86-power-control"
VIRTUAL-RUNTIME_obmc-chassis-state-manager ?= "x86-power-control"
```

## meta-volans/conf/layer.conf
```bitbake
# We have a conf and classes directory, add to BBPATH
BBPATH .= ":${LAYERDIR}"

# We have recipes-* directories, add to BBFILES
BBFILES += "${LAYERDIR}/recipes-*/*/*.bb \
            ${LAYERDIR}/recipes-*/*/*.bbappend"

BBFILE_COLLECTIONS += "meta-volans"
BBFILE_PATTERN_meta-volans = "^${LAYERDIR}/"

LAYERSERIES_COMPAT_meta-volans = "nanbield scarthgap"
LAYERDEPENDS_meta-volans = "meta-aic"

PREFERRED_PROVIDER_virtual/phosphor-led-manager-config-native = "volans-led-manager-config-native"

VIRTUAL-RUNTIME_obmc-host-state-manager ?= "x86-power-control"
VIRTUAL-RUNTIME_obmc-chassis-state-manager ?= "x86-power-control"

VIRTUAL-RUNTIME_obmc-inventory-manager = "entity-manager"
PREFERRED_PROVIDER_virtual/obmc-inventory-data = "entity-manager"

MACHINE_FEATURES += " bonding "
```
